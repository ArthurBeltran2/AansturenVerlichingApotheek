/* USER CODE BEGIN Header */
/**
  ******************************************************************************
  * @file           : main.c
  * @brief          : Main program body
  ******************************************************************************
  * @attention
  *
  * <h2><center>&copy; Copyright (c) 2020 STMicroelectronics.
  * All rights reserved.</center></h2>
  *
  * This software component is licensed by ST under BSD 3-Clause license,
  * the "License"; You may not use this file except in compliance with the
  * License. You may obtain a copy of the License at:
  *                        opensource.org/licenses/BSD-3-Clause
  *
  ******************************************************************************
  * THis application reads 8 edge triggered digital inputs.
  * This is done in the ExtI_IN0_IN4_Callback() interrupt function
  *
  * These inputs are then used to Set/Reset (PWM) a corresponding output.
  * THe
  * The PWM  with setable duty cycle is done to lower/ average the output voltage.
  * The duty cycle level for the PWM is derived from an analog input. Set by an potentiometer.
  * THe PWM + Duty cycle is generated by TIM2 running in normal timer mode.
  * Each TIM2 Channel is responsible for signal of 2 outputs.
  * The output ommpare register is used to set dutycylce period
  * Each time the TIM2 counter reaches the CC output value the outputs are set or reset
  * and the CC register is reloaded with new value.
  * The High level the of 4channels thuse 8 outputs is spread in time to average/lower the peakcurrent.

  */
/* USER CODE END Header */
/* Includes ------------------------------------------------------------------*/
#include "main.h"

/* Private includes ----------------------------------------------------------*/
/* USER CODE BEGIN Includes */

/* USER CODE END Includes */

/* Private typedef -----------------------------------------------------------*/
/* USER CODE BEGIN PTD */
typedef enum
{
  INACTIVE = 0,
  ACTIVE = !INACTIVE
} IOStatus;
/* USER CODE END PTD */

/* Private define ------------------------------------------------------------*/
/* USER CODE BEGIN PD */
/* USER CODE END PD */

/* Private macro -------------------------------------------------------------*/
/* USER CODE BEGIN PM */

/* USER CODE END PM */

/* Private variables ---------------------------------------------------------*/

/* USER CODE BEGIN PV */
/*Variable used to define CH input status*/
uint32_t IN0Status = ACTIVE;
uint32_t IN1Status = INACTIVE;
uint32_t IN2Status = INACTIVE;
uint32_t IN3Status = INACTIVE;
uint32_t IN4Status = INACTIVE;
uint32_t IN5Status = INACTIVE;
uint32_t IN6Status = INACTIVE;
uint32_t IN7Status = INACTIVE;


/*Variables used in callback loop to define output signal*/
uint32_t TIM2CH1_EventCycle = 0;
uint32_t TIM2CH2_EventCycle = 0;
uint32_t TIM2CH3_EventCycle = 0;
uint32_t TIM2CH4_EventCycle = 0;

/*Variables used in callback loop to define output signal*/

uint32_t ReloadCounter = 65535;
uint32_t OffsetCount = 100; //define count offset
uint32_t DutyCycleCount = 40000; 	// define dutycycle of output

uint32_t CH1RiseCount = 0;
uint32_t CH1FallCount = 0;
uint32_t CH1DiffCount = 0;
uint32_t CH2RiseCount = 0;
uint32_t CH2FallCount = 0;
uint32_t CH3RiseCount = 0;
uint32_t CH3FallCount = 0;
uint32_t CH4RiseCount = 0;
uint32_t CH4FallCount = 0;
/*Variables are initialized in TIM2CountValues_init function*/


/* USER CODE END PV */

/* Private function prototypes -----------------------------------------------*/
void SystemClock_Config(void);
static void MX_GPIO_Init(void);
static void MX_ADC_Init(void);
static void MX_USART2_UART_Init(void);
static void MX_TIM2_Init(void);
/* USER CODE BEGIN PFP */
static void TIM2CountValues_init(void);
static void TIM2StartRunning(void);
static void MCO_ConfigGPIO(void);

/* USER CODE END PFP */

/* Private user code ---------------------------------------------------------*/
/* USER CODE BEGIN 0 */

/* USER CODE END 0 */

/**
  * @brief  The application entry point.
  * @retval int
  */
int main(void)
{
  /* USER CODE BEGIN 1 */

  /* USER CODE END 1 */

  /* MCU Configuration--------------------------------------------------------*/

  /* Reset of all peripherals, Initializes the Flash interface and the Systick. */

  LL_APB2_GRP1_EnableClock(LL_APB2_GRP1_PERIPH_SYSCFG);
  LL_APB1_GRP1_EnableClock(LL_APB1_GRP1_PERIPH_PWR);

  /* System interrupt init*/

  /* USER CODE BEGIN Init */

  /* USER CODE END Init */

  /* Configure the system clock */
  SystemClock_Config();

  /* USER CODE BEGIN SysInit */
  TIM2CountValues_init();
  /* USER CODE END SysInit */

  /* Initialize all configured peripherals */
  MX_GPIO_Init();
  MX_ADC_Init();
  MX_USART2_UART_Init();
  MX_TIM2_Init();
  /* USER CODE BEGIN 2 */

  TIM2StartRunning();
  /* USER CODE END 2 */

  /* Infinite loop */
  /* USER CODE BEGIN WHILE */
  while (1)
  {
    /* USER CODE END WHILE */

    /* USER CODE BEGIN 3 */
  }
  /* USER CODE END 3 */
}

/**
  * @brief System Clock Configuration
  * @retval None
  */
void SystemClock_Config(void)
{
  LL_FLASH_SetLatency(LL_FLASH_LATENCY_0);
  while(LL_FLASH_GetLatency()!= LL_FLASH_LATENCY_0)
  {
  }
  LL_PWR_SetRegulVoltageScaling(LL_PWR_REGU_VOLTAGE_SCALE1);
  LL_RCC_HSI_Enable();

   /* Wait till HSI is ready */
  while(LL_RCC_HSI_IsReady() != 1)
  {

  }
  LL_RCC_HSI_SetCalibTrimming(16);
  LL_RCC_SetAHBPrescaler(LL_RCC_SYSCLK_DIV_1);
  LL_RCC_SetAPB1Prescaler(LL_RCC_APB1_DIV_8);
  LL_RCC_SetAPB2Prescaler(LL_RCC_APB2_DIV_8);
  LL_RCC_SetSysClkSource(LL_RCC_SYS_CLKSOURCE_HSI);

   /* Wait till System clock is ready */
  while(LL_RCC_GetSysClkSource() != LL_RCC_SYS_CLKSOURCE_STATUS_HSI)
  {

  }

  LL_Init1msTick(16000000);

  LL_SetSystemCoreClock(16000000);
  LL_RCC_SetUSARTClockSource(LL_RCC_USART2_CLKSOURCE_PCLK1);
}

/**
  * @brief ADC Initialization Function
  * @param None
  * @retval None
  */
static void MX_ADC_Init(void)
{

  /* USER CODE BEGIN ADC_Init 0 */

  /* USER CODE END ADC_Init 0 */

  LL_ADC_REG_InitTypeDef ADC_REG_InitStruct = {0};
  LL_ADC_InitTypeDef ADC_InitStruct = {0};

  LL_GPIO_InitTypeDef GPIO_InitStruct = {0};

  /* Peripheral clock enable */
  LL_APB2_GRP1_EnableClock(LL_APB2_GRP1_PERIPH_ADC1);

  LL_IOP_GRP1_EnableClock(LL_IOP_GRP1_PERIPH_GPIOA);
  /**ADC GPIO Configuration
  PA0-CK_IN   ------> ADC_IN0
  */
  GPIO_InitStruct.Pin = LL_GPIO_PIN_0;
  GPIO_InitStruct.Mode = LL_GPIO_MODE_ANALOG;
  GPIO_InitStruct.Pull = LL_GPIO_PULL_NO;
  LL_GPIO_Init(GPIOA, &GPIO_InitStruct);

  /* ADC interrupt Init */
  NVIC_SetPriority(ADC1_COMP_IRQn, 0);
  NVIC_EnableIRQ(ADC1_COMP_IRQn);

  /* USER CODE BEGIN ADC_Init 1 */

  /* USER CODE END ADC_Init 1 */
  /** Configure Regular Channel
  */
  LL_ADC_REG_SetSequencerChAdd(ADC1, LL_ADC_CHANNEL_0);
  /** Common config
  */
  ADC_REG_InitStruct.TriggerSource = LL_ADC_REG_TRIG_SOFTWARE;
  ADC_REG_InitStruct.SequencerDiscont = LL_ADC_REG_SEQ_DISCONT_DISABLE;
  ADC_REG_InitStruct.ContinuousMode = LL_ADC_REG_CONV_SINGLE;
  ADC_REG_InitStruct.DMATransfer = LL_ADC_REG_DMA_TRANSFER_NONE;
  ADC_REG_InitStruct.Overrun = LL_ADC_REG_OVR_DATA_PRESERVED;
  LL_ADC_REG_Init(ADC1, &ADC_REG_InitStruct);
  LL_ADC_SetSamplingTimeCommonChannels(ADC1, LL_ADC_SAMPLINGTIME_1CYCLE_5);
  LL_ADC_SetOverSamplingScope(ADC1, LL_ADC_OVS_DISABLE);
  LL_ADC_REG_SetSequencerScanDirection(ADC1, LL_ADC_REG_SEQ_SCAN_DIR_FORWARD);
  LL_ADC_SetCommonFrequencyMode(__LL_ADC_COMMON_INSTANCE(ADC1), LL_ADC_CLOCK_FREQ_MODE_LOW);
  LL_ADC_DisableIT_EOC(ADC1);
  LL_ADC_DisableIT_EOS(ADC1);

   /* Enable ADC internal voltage regulator */
   LL_ADC_EnableInternalRegulator(ADC1);
   /* Delay for ADC internal voltage regulator stabilization. */
   /* Compute number of CPU cycles to wait for, from delay in us. */
   /* Note: Variable divided by 2 to compensate partially */
   /* CPU processing cycles (depends on compilation optimization). */
   /* Note: If system core clock frequency is below 200kHz, wait time */
   /* is only a few CPU processing cycles. */
   uint32_t wait_loop_index;
   wait_loop_index = ((LL_ADC_DELAY_INTERNAL_REGUL_STAB_US * (SystemCoreClock / (100000 * 2))) / 10);
   while(wait_loop_index != 0)
     {
   wait_loop_index--;
     }
  ADC_InitStruct.Clock = LL_ADC_CLOCK_SYNC_PCLK_DIV2;
  ADC_InitStruct.Resolution = LL_ADC_RESOLUTION_12B;
  ADC_InitStruct.DataAlignment = LL_ADC_DATA_ALIGN_RIGHT;
  ADC_InitStruct.LowPowerMode = LL_ADC_LP_MODE_NONE;
  LL_ADC_Init(ADC1, &ADC_InitStruct);
  /* USER CODE BEGIN ADC_Init 2 */

  /* USER CODE END ADC_Init 2 */

}

/**
  * @brief TIM2 Initialization Function
  * @param None
  * @retval None
  */
static void MX_TIM2_Init(void)
{

  /* USER CODE BEGIN TIM2_Init 0 */

  /* USER CODE END TIM2_Init 0 */

  LL_TIM_InitTypeDef TIM_InitStruct = {0};
  LL_TIM_OC_InitTypeDef TIM_OC_InitStruct = {0};

  /* Peripheral clock enable */
  LL_APB1_GRP1_EnableClock(LL_APB1_GRP1_PERIPH_TIM2);

  /* TIM2 interrupt Init */
  NVIC_SetPriority(TIM2_IRQn, 0);
  NVIC_EnableIRQ(TIM2_IRQn);

  /* USER CODE BEGIN TIM2_Init 1 */

  /* USER CODE END TIM2_Init 1 */
  TIM_InitStruct.Prescaler = 0;
  TIM_InitStruct.CounterMode = LL_TIM_COUNTERMODE_UP;
  TIM_InitStruct.Autoreload = 65535;
  TIM_InitStruct.ClockDivision = LL_TIM_CLOCKDIVISION_DIV1;
  LL_TIM_Init(TIM2, &TIM_InitStruct);
  LL_TIM_DisableARRPreload(TIM2);
  LL_TIM_SetClockSource(TIM2, LL_TIM_CLOCKSOURCE_INTERNAL);
  TIM_OC_InitStruct.OCMode = LL_TIM_OCMODE_FROZEN;
  TIM_OC_InitStruct.OCState = LL_TIM_OCSTATE_DISABLE;
  TIM_OC_InitStruct.CompareValue = 0;
  TIM_OC_InitStruct.OCPolarity = LL_TIM_OCPOLARITY_HIGH;
  LL_TIM_OC_Init(TIM2, LL_TIM_CHANNEL_CH1, &TIM_OC_InitStruct);
  LL_TIM_OC_DisableFast(TIM2, LL_TIM_CHANNEL_CH1);
  TIM_OC_InitStruct.OCState = LL_TIM_OCSTATE_DISABLE;
  LL_TIM_OC_Init(TIM2, LL_TIM_CHANNEL_CH2, &TIM_OC_InitStruct);
  LL_TIM_OC_DisableFast(TIM2, LL_TIM_CHANNEL_CH2);
  TIM_OC_InitStruct.OCState = LL_TIM_OCSTATE_DISABLE;
  LL_TIM_OC_Init(TIM2, LL_TIM_CHANNEL_CH3, &TIM_OC_InitStruct);
  LL_TIM_OC_DisableFast(TIM2, LL_TIM_CHANNEL_CH3);
  TIM_OC_InitStruct.OCState = LL_TIM_OCSTATE_DISABLE;
  LL_TIM_OC_Init(TIM2, LL_TIM_CHANNEL_CH4, &TIM_OC_InitStruct);
  LL_TIM_OC_DisableFast(TIM2, LL_TIM_CHANNEL_CH4);
  LL_TIM_SetTriggerOutput(TIM2, LL_TIM_TRGO_RESET);
  LL_TIM_DisableMasterSlaveMode(TIM2);
  /* USER CODE BEGIN TIM2_Init 2 */
  /**************************/

  /* USER CODE END TIM2_Init 2 */

}

/**
  * @brief USART2 Initialization Function
  * @param None
  * @retval None
  */
static void MX_USART2_UART_Init(void)
{

  /* USER CODE BEGIN USART2_Init 0 */

  /* USER CODE END USART2_Init 0 */

  LL_USART_InitTypeDef USART_InitStruct = {0};

  LL_GPIO_InitTypeDef GPIO_InitStruct = {0};

  /* Peripheral clock enable */
  LL_APB1_GRP1_EnableClock(LL_APB1_GRP1_PERIPH_USART2);

  LL_IOP_GRP1_EnableClock(LL_IOP_GRP1_PERIPH_GPIOA);
  /**USART2 GPIO Configuration
  PA2   ------> USART2_TX
  PA15   ------> USART2_RX
  */
  GPIO_InitStruct.Pin = VCP_TX_Pin;
  GPIO_InitStruct.Mode = LL_GPIO_MODE_ALTERNATE;
  GPIO_InitStruct.Speed = LL_GPIO_SPEED_FREQ_VERY_HIGH;
  GPIO_InitStruct.OutputType = LL_GPIO_OUTPUT_PUSHPULL;
  GPIO_InitStruct.Pull = LL_GPIO_PULL_NO;
  GPIO_InitStruct.Alternate = LL_GPIO_AF_4;
  LL_GPIO_Init(VCP_TX_GPIO_Port, &GPIO_InitStruct);

  GPIO_InitStruct.Pin = VCP_RX_Pin;
  GPIO_InitStruct.Mode = LL_GPIO_MODE_ALTERNATE;
  GPIO_InitStruct.Speed = LL_GPIO_SPEED_FREQ_VERY_HIGH;
  GPIO_InitStruct.OutputType = LL_GPIO_OUTPUT_PUSHPULL;
  GPIO_InitStruct.Pull = LL_GPIO_PULL_NO;
  GPIO_InitStruct.Alternate = LL_GPIO_AF_4;
  LL_GPIO_Init(VCP_RX_GPIO_Port, &GPIO_InitStruct);

  /* USER CODE BEGIN USART2_Init 1 */

  /* USER CODE END USART2_Init 1 */
  USART_InitStruct.BaudRate = 115200;
  USART_InitStruct.DataWidth = LL_USART_DATAWIDTH_8B;
  USART_InitStruct.StopBits = LL_USART_STOPBITS_1;
  USART_InitStruct.Parity = LL_USART_PARITY_NONE;
  USART_InitStruct.TransferDirection = LL_USART_DIRECTION_TX_RX;
  USART_InitStruct.HardwareFlowControl = LL_USART_HWCONTROL_NONE;
  USART_InitStruct.OverSampling = LL_USART_OVERSAMPLING_16;
  LL_USART_Init(USART2, &USART_InitStruct);
  LL_USART_ConfigAsyncMode(USART2);
  LL_USART_Enable(USART2);
  /* USER CODE BEGIN USART2_Init 2 */

  /* USER CODE END USART2_Init 2 */

}

/**
  * @brief GPIO Initialization Function
  * @param None
  * @retval None
  */
static void MX_GPIO_Init(void)
{
  LL_EXTI_InitTypeDef EXTI_InitStruct = {0};
  LL_GPIO_InitTypeDef GPIO_InitStruct = {0};

  /* GPIO Ports Clock Enable */
  LL_IOP_GRP1_EnableClock(LL_IOP_GRP1_PERIPH_GPIOC);
  LL_IOP_GRP1_EnableClock(LL_IOP_GRP1_PERIPH_GPIOA);
  LL_IOP_GRP1_EnableClock(LL_IOP_GRP1_PERIPH_GPIOB);

  /**/
  LL_GPIO_ResetOutputPin(OUT0_GPIO_Port, OUT0_Pin);

  /**/
  LL_GPIO_ResetOutputPin(OUT1_GPIO_Port, OUT1_Pin);

  /**/
  LL_GPIO_ResetOutputPin(OUT2_GPIO_Port, OUT2_Pin);

  /**/
  LL_GPIO_ResetOutputPin(OUT3_GPIO_Port, OUT3_Pin);

  /**/
  LL_GPIO_ResetOutputPin(OUT4_GPIO_Port, OUT4_Pin);

  /**/
  LL_GPIO_ResetOutputPin(OUT5_GPIO_Port, OUT5_Pin);

  /**/
  LL_GPIO_ResetOutputPin(OUT7_GPIO_Port, OUT7_Pin);

  /**/
  LL_GPIO_ResetOutputPin(OUT6_GPIO_Port, OUT6_Pin);

  /**/
  LL_GPIO_ResetOutputPin(LD3_GPIO_Port, LD3_Pin);

  /**/
  GPIO_InitStruct.Pin = OUT0_Pin;
  GPIO_InitStruct.Mode = LL_GPIO_MODE_OUTPUT;
  GPIO_InitStruct.Speed = LL_GPIO_SPEED_FREQ_LOW;
  GPIO_InitStruct.OutputType = LL_GPIO_OUTPUT_PUSHPULL;
  GPIO_InitStruct.Pull = LL_GPIO_PULL_NO;
  LL_GPIO_Init(OUT0_GPIO_Port, &GPIO_InitStruct);

  /**/
  GPIO_InitStruct.Pin = OUT1_Pin;
  GPIO_InitStruct.Mode = LL_GPIO_MODE_OUTPUT;
  GPIO_InitStruct.Speed = LL_GPIO_SPEED_FREQ_LOW;
  GPIO_InitStruct.OutputType = LL_GPIO_OUTPUT_PUSHPULL;
  GPIO_InitStruct.Pull = LL_GPIO_PULL_NO;
  LL_GPIO_Init(OUT1_GPIO_Port, &GPIO_InitStruct);

  /**/
  GPIO_InitStruct.Pin = OUT2_Pin;
  GPIO_InitStruct.Mode = LL_GPIO_MODE_OUTPUT;
  GPIO_InitStruct.Speed = LL_GPIO_SPEED_FREQ_LOW;
  GPIO_InitStruct.OutputType = LL_GPIO_OUTPUT_PUSHPULL;
  GPIO_InitStruct.Pull = LL_GPIO_PULL_NO;
  LL_GPIO_Init(OUT2_GPIO_Port, &GPIO_InitStruct);

  /**/
  GPIO_InitStruct.Pin = OUT3_Pin;
  GPIO_InitStruct.Mode = LL_GPIO_MODE_OUTPUT;
  GPIO_InitStruct.Speed = LL_GPIO_SPEED_FREQ_LOW;
  GPIO_InitStruct.OutputType = LL_GPIO_OUTPUT_PUSHPULL;
  GPIO_InitStruct.Pull = LL_GPIO_PULL_NO;
  LL_GPIO_Init(OUT3_GPIO_Port, &GPIO_InitStruct);

  /**/
  GPIO_InitStruct.Pin = OUT4_Pin;
  GPIO_InitStruct.Mode = LL_GPIO_MODE_OUTPUT;
  GPIO_InitStruct.Speed = LL_GPIO_SPEED_FREQ_LOW;
  GPIO_InitStruct.OutputType = LL_GPIO_OUTPUT_PUSHPULL;
  GPIO_InitStruct.Pull = LL_GPIO_PULL_NO;
  LL_GPIO_Init(OUT4_GPIO_Port, &GPIO_InitStruct);

  /**/
  GPIO_InitStruct.Pin = OUT5_Pin;
  GPIO_InitStruct.Mode = LL_GPIO_MODE_OUTPUT;
  GPIO_InitStruct.Speed = LL_GPIO_SPEED_FREQ_LOW;
  GPIO_InitStruct.OutputType = LL_GPIO_OUTPUT_PUSHPULL;
  GPIO_InitStruct.Pull = LL_GPIO_PULL_NO;
  LL_GPIO_Init(OUT5_GPIO_Port, &GPIO_InitStruct);

  /**/
  GPIO_InitStruct.Pin = OUT7_Pin;
  GPIO_InitStruct.Mode = LL_GPIO_MODE_OUTPUT;
  GPIO_InitStruct.Speed = LL_GPIO_SPEED_FREQ_LOW;
  GPIO_InitStruct.OutputType = LL_GPIO_OUTPUT_PUSHPULL;
  GPIO_InitStruct.Pull = LL_GPIO_PULL_NO;
  LL_GPIO_Init(OUT7_GPIO_Port, &GPIO_InitStruct);

  /**/
  GPIO_InitStruct.Pin = OUT6_Pin;
  GPIO_InitStruct.Mode = LL_GPIO_MODE_OUTPUT;
  GPIO_InitStruct.Speed = LL_GPIO_SPEED_FREQ_LOW;
  GPIO_InitStruct.OutputType = LL_GPIO_OUTPUT_PUSHPULL;
  GPIO_InitStruct.Pull = LL_GPIO_PULL_NO;
  LL_GPIO_Init(OUT6_GPIO_Port, &GPIO_InitStruct);

  /**/
  GPIO_InitStruct.Pin = LD3_Pin;
  GPIO_InitStruct.Mode = LL_GPIO_MODE_OUTPUT;
  GPIO_InitStruct.Speed = LL_GPIO_SPEED_FREQ_LOW;
  GPIO_InitStruct.OutputType = LL_GPIO_OUTPUT_PUSHPULL;
  GPIO_InitStruct.Pull = LL_GPIO_PULL_NO;
  LL_GPIO_Init(LD3_GPIO_Port, &GPIO_InitStruct);

  /**/
  LL_SYSCFG_SetEXTISource(LL_SYSCFG_EXTI_PORTB, LL_SYSCFG_EXTI_LINE0);

  /**/
  LL_SYSCFG_SetEXTISource(LL_SYSCFG_EXTI_PORTB, LL_SYSCFG_EXTI_LINE1);

  /**/
  LL_SYSCFG_SetEXTISource(LL_SYSCFG_EXTI_PORTA, LL_SYSCFG_EXTI_LINE8);

  /**/
  LL_SYSCFG_SetEXTISource(LL_SYSCFG_EXTI_PORTA, LL_SYSCFG_EXTI_LINE9);

  /**/
  LL_SYSCFG_SetEXTISource(LL_SYSCFG_EXTI_PORTA, LL_SYSCFG_EXTI_LINE11);

  /**/
  LL_SYSCFG_SetEXTISource(LL_SYSCFG_EXTI_PORTB, LL_SYSCFG_EXTI_LINE4);

  /**/
  LL_SYSCFG_SetEXTISource(LL_SYSCFG_EXTI_PORTB, LL_SYSCFG_EXTI_LINE5);

  /**/
  LL_SYSCFG_SetEXTISource(LL_SYSCFG_EXTI_PORTB, LL_SYSCFG_EXTI_LINE6);

  /**/
  LL_SYSCFG_SetEXTISource(LL_SYSCFG_EXTI_PORTB, LL_SYSCFG_EXTI_LINE7);

  /**/
  LL_GPIO_SetPinPull(IN7_GPIO_Port, IN7_Pin, LL_GPIO_PULL_NO);

  /**/
  LL_GPIO_SetPinPull(IN4_GPIO_Port, IN4_Pin, LL_GPIO_PULL_NO);

  /**/
  LL_GPIO_SetPinPull(IN3_GPIO_Port, IN3_Pin, LL_GPIO_PULL_NO);

  /**/
  LL_GPIO_SetPinPull(user_button_GPIO_Port, user_button_Pin, LL_GPIO_PULL_UP);

  /**/
  LL_GPIO_SetPinPull(IN2_GPIO_Port, IN2_Pin, LL_GPIO_PULL_NO);

  /**/
  LL_GPIO_SetPinPull(IN0_GPIO_Port, IN0_Pin, LL_GPIO_PULL_NO);

  /**/
  LL_GPIO_SetPinPull(IN1_GPIO_Port, IN1_Pin, LL_GPIO_PULL_NO);

  /**/
  LL_GPIO_SetPinPull(IN5_GPIO_Port, IN5_Pin, LL_GPIO_PULL_NO);

  /**/
  LL_GPIO_SetPinPull(IN6_GPIO_Port, IN6_Pin, LL_GPIO_PULL_NO);

  /**/
  LL_GPIO_SetPinMode(IN7_GPIO_Port, IN7_Pin, LL_GPIO_MODE_INPUT);

  /**/
  LL_GPIO_SetPinMode(IN4_GPIO_Port, IN4_Pin, LL_GPIO_MODE_INPUT);

  /**/
  LL_GPIO_SetPinMode(IN3_GPIO_Port, IN3_Pin, LL_GPIO_MODE_INPUT);

  /**/
  LL_GPIO_SetPinMode(user_button_GPIO_Port, user_button_Pin, LL_GPIO_MODE_INPUT);

  /**/
  LL_GPIO_SetPinMode(IN2_GPIO_Port, IN2_Pin, LL_GPIO_MODE_INPUT);

  /**/
  LL_GPIO_SetPinMode(IN0_GPIO_Port, IN0_Pin, LL_GPIO_MODE_INPUT);

  /**/
  LL_GPIO_SetPinMode(IN1_GPIO_Port, IN1_Pin, LL_GPIO_MODE_INPUT);

  /**/
  LL_GPIO_SetPinMode(IN5_GPIO_Port, IN5_Pin, LL_GPIO_MODE_INPUT);

  /**/
  LL_GPIO_SetPinMode(IN6_GPIO_Port, IN6_Pin, LL_GPIO_MODE_INPUT);

  /**/
  EXTI_InitStruct.Line_0_31 = LL_EXTI_LINE_0;
  EXTI_InitStruct.LineCommand = ENABLE;
  EXTI_InitStruct.Mode = LL_EXTI_MODE_IT;
  EXTI_InitStruct.Trigger = LL_EXTI_TRIGGER_RISING;
  LL_EXTI_Init(&EXTI_InitStruct);

  /**/
  EXTI_InitStruct.Line_0_31 = LL_EXTI_LINE_1;
  EXTI_InitStruct.LineCommand = ENABLE;
  EXTI_InitStruct.Mode = LL_EXTI_MODE_IT;
  EXTI_InitStruct.Trigger = LL_EXTI_TRIGGER_RISING;
  LL_EXTI_Init(&EXTI_InitStruct);

  /**/
  EXTI_InitStruct.Line_0_31 = LL_EXTI_LINE_8;
  EXTI_InitStruct.LineCommand = ENABLE;
  EXTI_InitStruct.Mode = LL_EXTI_MODE_IT;
  EXTI_InitStruct.Trigger = LL_EXTI_TRIGGER_RISING;
  LL_EXTI_Init(&EXTI_InitStruct);

  /**/
  EXTI_InitStruct.Line_0_31 = LL_EXTI_LINE_9;
  EXTI_InitStruct.LineCommand = ENABLE;
  EXTI_InitStruct.Mode = LL_EXTI_MODE_IT;
  EXTI_InitStruct.Trigger = LL_EXTI_TRIGGER_FALLING;
  LL_EXTI_Init(&EXTI_InitStruct);

  /**/
  EXTI_InitStruct.Line_0_31 = LL_EXTI_LINE_11;
  EXTI_InitStruct.LineCommand = ENABLE;
  EXTI_InitStruct.Mode = LL_EXTI_MODE_IT;
  EXTI_InitStruct.Trigger = LL_EXTI_TRIGGER_RISING;
  LL_EXTI_Init(&EXTI_InitStruct);

  /**/
  EXTI_InitStruct.Line_0_31 = LL_EXTI_LINE_4;
  EXTI_InitStruct.LineCommand = ENABLE;
  EXTI_InitStruct.Mode = LL_EXTI_MODE_IT;
  EXTI_InitStruct.Trigger = LL_EXTI_TRIGGER_RISING_FALLING;
  LL_EXTI_Init(&EXTI_InitStruct);

  /**/
  EXTI_InitStruct.Line_0_31 = LL_EXTI_LINE_5;
  EXTI_InitStruct.LineCommand = ENABLE;
  EXTI_InitStruct.Mode = LL_EXTI_MODE_IT;
  EXTI_InitStruct.Trigger = LL_EXTI_TRIGGER_RISING;
  LL_EXTI_Init(&EXTI_InitStruct);

  /**/
  EXTI_InitStruct.Line_0_31 = LL_EXTI_LINE_6;
  EXTI_InitStruct.LineCommand = ENABLE;
  EXTI_InitStruct.Mode = LL_EXTI_MODE_IT;
  EXTI_InitStruct.Trigger = LL_EXTI_TRIGGER_RISING;
  LL_EXTI_Init(&EXTI_InitStruct);

  /**/
  EXTI_InitStruct.Line_0_31 = LL_EXTI_LINE_7;
  EXTI_InitStruct.LineCommand = ENABLE;
  EXTI_InitStruct.Mode = LL_EXTI_MODE_IT;
  EXTI_InitStruct.Trigger = LL_EXTI_TRIGGER_RISING;
  LL_EXTI_Init(&EXTI_InitStruct);

  /* EXTI interrupt init*/
  NVIC_SetPriority(EXTI0_1_IRQn, 0);
  NVIC_EnableIRQ(EXTI0_1_IRQn);
  NVIC_SetPriority(EXTI4_15_IRQn, 0);
  NVIC_EnableIRQ(EXTI4_15_IRQn);

}

/* USER CODE BEGIN 4 */
/**
  * @brief  This function is executed in case of change of duty cycle values
  * @Dutycycle is measured at with voltage at ADC CH0  3V3 = 100%
  *   * @retval None
  */


/**
  * @brief Define PWM period and duty Cylce of CH1 to CH4 signals
  * Define Start of rising and falling edge of for TIM2 channels
  * Duty cycle is measured via ADC
  * All channels have the same PWM and Duty cycle. But the PWM between the the channels is shifted in time
  * This is done to avoid all channels are ON at the same time.
  * thus keep the peak of the common current as low as possible.
  *   * @retval None
  */

void TIM2CountValues_init(void)
{
	CH1RiseCount = OffsetCount % ReloadCounter;  // by taking modulus our counter values stay below Reload counter value
	CH1FallCount = (CH1RiseCount + DutyCycleCount) % ReloadCounter;

	CH2RiseCount = (CH1FallCount + OffsetCount) % ReloadCounter;
	CH2FallCount = (CH2RiseCount + DutyCycleCount) % ReloadCounter;

	CH3RiseCount = (CH2FallCount + OffsetCount) % ReloadCounter;
	CH3FallCount = (CH3RiseCount + DutyCycleCount) % ReloadCounter;

	CH4RiseCount = (CH3FallCount + OffsetCount) % ReloadCounter;
	CH4FallCount = (CH4RiseCount + DutyCycleCount) % ReloadCounter;
}
void TIM2StartRunning(void)
{
 /*Done in the EXtI_INx_INxCallback function */
 /*********************************************************************/
 /*Set CH1 first Rising edge to correct value*/
 //LL_TIM_OC_SetCompareCH1(TIM2,CH1RiseCount);

 /* TIM2 interrupts set-up */
 /**************************/
 /* Enable the capture/compare interrupt for channel 1*/
 //LL_TIM_EnableIT_CC1(TIM2);
 /*********************************************************************/
 /* Enable counter */
 LL_TIM_EnableCounter(TIM2);
 }

/**
  * @brief TIM2 CC Interrupt routine , activated when match between counter of TIM2 with CC register CH1.
  *
  * TIM2 is an up counter.
  * The counter counts till it matches the value in the auto reload register set in the TIM2 init routine
  * after the match the counter resets to 0. (no interrupts are generated)
  *
  * This interrupt routine generates the PWM / Dutycycle signal of output CH0 and CH4
  * The PWM signal is broken up in different Event Cycles.
  * In this case 2 event cycles during the whole TIM2 count.
  * Each event cycle defines the number of clock counts the signal needs to be high or low
  * One event cycles defines the high period of the PWM signal
  * One event cycle defines the low period of the PWM signal
  * The high periode is counted in number of TIM2 clock cycles and calculated in the TIM2CountValues-Init
  * The low periode is counted in number of TIM2  clock cycles and calculated in the TIM2CountValues-Init

  * Whether the TIM2 CCx counts and whether an output pin is set depends on the variable INxStatus
  * This INxStatus is set in the EXTI_IN0_IN4_callback routine
  * @retval None
  */

void TIM2CaptureCompareCH1_Callback(void)
{
	//Test signal
	LL_GPIO_TogglePin(LD3_GPIO_Port,LD3_Pin); //channel A on Scope

    if (TIM2CH1_EventCycle == 0)
    {
    	/*Set CH1 OC value to next matching value = CH1FallCount*/
    	LL_TIM_OC_SetCompareCH1(TIM2,CH1FallCount);

  	    /* Set Output Active High */
  	    if (IN0Status==ACTIVE) { LL_GPIO_SetOutputPin(OUT0_GPIO_Port,OUT0_Pin);}
  	    if (IN4Status==ACTIVE) { LL_GPIO_SetOutputPin(OUT4_GPIO_Port,OUT4_Pin);}
  	    TIM2CH1_EventCycle++;

    }
    else if (TIM2CH1_EventCycle >= 1)
	{
    	/*Set CH1 OC value to next matching value = CH1RiseCount*/
    	LL_TIM_OC_SetCompareCH1(TIM2,CH1RiseCount);

    	/* Set Output Active Low */
    	LL_GPIO_ResetOutputPin(OUT0_GPIO_Port,OUT0_Pin);
    	LL_GPIO_ResetOutputPin(OUT4_GPIO_Port,OUT4_Pin);
    	TIM2CH1_EventCycle = 0;
    }
}

void TIM2CaptureCompareCH2_Callback(void)
{
}

void TIM2CaptureCompareCH3_Callback(void)
{
}

void TIM2CaptureCompareCH4_Callback(void)
{
}

/**
  * @brief  Interrupt routine when edge is detected at input 1 or 4
  * To the inputs a toggle button is connected. when button is toggled,
  * function checks input level for high or low
  * depending the status the corresponding output is activated or deactivated.
  * activation is done by setting variable INxStatus
  * This INxStatus is used by the TIM2  to see if the corresponding output should be PWMm'd or not
  * @retval None
  */

void ExtI_IN0_IN4_Callback(void)
{
	/*In case of rising edge IN0 or IN4 Status is ACTIVE else */
	/*In case of falling edge IN0 or IN4 Status is INACTIVE*/
	IN0Status = LL_GPIO_IsInputPinSet(IN0_GPIO_Port, IN0_Pin); /*Read level of input pin0 into IN0Status variable*/
	IN4Status = LL_GPIO_IsInputPinSet(IN4_GPIO_Port, IN4_Pin); /*Read level of input pin4 into IN4Status variable*/

	if ((IN0Status == ACTIVE) || (IN4Status == ACTIVE)) /*True in case INO or I4 is High*/
	{
		if (LL_TIM_IsEnabledIT_CC1(TIM2)==0)  		/*In case channel 1 CC register of TIM2 not enabled.*/
		{											/*occurs when both outputs where previous OFF or LOW*/

			LL_TIM_OC_SetCompareCH1(TIM2,CH1RiseCount); /*Set CH1 first Rising edge to correct value*/
			/*Enable interrupt CC*/
			LL_TIM_EnableIT_CC1(TIM2);				/* Enable the capture/compare interrupt for channel 1*/
			/*start CH1 of TIM2*/
			LL_TIM_EnableIT_CC1(TIM2);				/*enable CC1 timer2*/
		}
	}
	/*When both inputs are LOW the TIM2 CH1 can stop counting*/
	if ((IN0Status == INACTIVE) && (IN4Status == INACTIVE))
	{
		LL_TIM_DisableIT_CC1(TIM2);			/*disable CC1 timer2*/
	}
}
void ExtI_IN1_IN5_Callback(void)
{
	/*In case of rising edge IN1 or IN5 -> IN Status is ACTIVE else */
	/*In case of falling edge IN1 or IN5 -> IN Status is INACTIVE*/
	IN1Status = LL_GPIO_IsInputPinSet(IN0_GPIO_Port, IN1_Pin); /*Read level of input pin into INStatus variable*/
	IN5Status = LL_GPIO_IsInputPinSet(IN4_GPIO_Port, IN5_Pin); /*Read level of input pin into INtatus variable*/

	if ((IN1Status == ACTIVE) || (IN5Status == ACTIVE)) /*True in case IN1 or IN5 is High*/
	{
		if (LL_TIM_IsEnabledIT_CC2(TIM2)==0)  		/*In case channel 2 CC register of TIM2 not enabled.*/
		{											/*occurs when both outputs where previous OFF or LOW */
			LL_TIM_OC_SetCompareCH2(TIM2,CH2RiseCount); /*Set CH1 first Rising edge to correct value*/
			/*Enable interrupt CC*/
			LL_TIM_EnableIT_CC2(TIM2);				/* Enable the capture/compare interrupt for channel 1*/
			/*start CH1 of TIM2*/
			LL_TIM_EnableIT_CC2(TIM2);				/*enable CC1 timer2*/
		}
	}
	/*When both inputs are LOW the TIM2 Channel can stop counting*/
	if ((IN1Status == INACTIVE) && (IN5Status == INACTIVE))
	{
		LL_TIM_DisableIT_CC2(TIM2);			/*disable CC counting timer2*/
	}
}
void ExtI_IN2_IN6_Callback(void)
{
	/*In case of rising edge IN2 or IN6 -> IN Status is ACTIVE else */
	/*In case of falling edge IN2 or IN6 -> IN Status is INACTIVE*/
	IN2Status = LL_GPIO_IsInputPinSet(IN0_GPIO_Port, IN2_Pin); /*Read level of input pin into INStatus variable*/
	IN6Status = LL_GPIO_IsInputPinSet(IN4_GPIO_Port, IN6_Pin); /*Read level of input pin into INtatus variable*/

	if ((IN2Status == ACTIVE) || (IN6Status == ACTIVE)) /*True in case IN1 or IN5 is High*/
	{
		if (LL_TIM_IsEnabledIT_CC3(TIM2)==0)  		/*In case channel 2 CC register of TIM2 not enabled.*/
		{											/*occurs when both outputs where previous OFF or LOW */
			LL_TIM_OC_SetCompareCH3(TIM2,CH3RiseCount); /*Set CH1 first Rising edge to correct value*/
			/*Enable interrupt CC*/
			LL_TIM_EnableIT_CC3(TIM2);				/* Enable the capture/compare interrupt for channel 1*/
			/*start CH1 of TIM2*/
			LL_TIM_EnableIT_CC3(TIM2);				/*enable CC1 timer2*/
		}
	}
	/*When both inputs are LOW the TIM2 Channel can stop counting*/
	if ((IN2Status == INACTIVE) && (IN6Status == INACTIVE))
	{
		LL_TIM_DisableIT_CC3(TIM2);			/*disable CC counting timer2*/
	}
}
void ExtI_IN3_IN7_Callback(void)
{
	/*In case of rising edge IN2 or IN6 -> IN Status is ACTIVE else */
	/*In case of falling edge IN2 or IN6 -> IN Status is INACTIVE*/
	IN3Status = LL_GPIO_IsInputPinSet(IN3_GPIO_Port, IN3_Pin); /*Read level of input pin into INStatus variable*/
	IN7Status = LL_GPIO_IsInputPinSet(IN7_GPIO_Port, IN7_Pin); /*Read level of input pin into INtatus variable*/

	if ((IN3Status == ACTIVE) || (IN7Status == ACTIVE)) /*True in case IN1 or IN5 is High*/
	{
		if (LL_TIM_IsEnabledIT_CC4(TIM2)==0)  		/*In case channel 2 CC register of TIM2 not enabled.*/
		{											/*occurs when both outputs where previous OFF or LOW */
			LL_TIM_OC_SetCompareCH4(TIM2,CH4RiseCount); /*Set CH1 first Rising edge to correct value*/
			/*Enable interrupt CC*/
			LL_TIM_EnableIT_CC4(TIM2);				/* Enable the capture/compare interrupt for channel 1*/
			/*start CH1 of TIM2*/
			LL_TIM_EnableIT_CC4(TIM2);				/*enable CC1 timer2*/
		}
	}
	/*When both inputs are LOW the TIM2 Channel can stop counting*/
	if ((IN3Status == INACTIVE) && (IN7Status == INACTIVE))
	{
		LL_TIM_DisableIT_CC4(TIM2);			/*disable CC counting timer2*/
	}
}
/**
      * @brief  Configure MCO pin (PA8).
      * @param  None
      * @retval None
      */
void MCO_ConfigGPIO(void)
{
/* Configue the MCO pin in alternate function mode */
     LL_GPIO_SetPinMode(GPIOA, LL_GPIO_PIN_8, LL_GPIO_MODE_ALTERNATE);
     LL_GPIO_SetPinOutputType(GPIOA, LL_GPIO_PIN_8, LL_GPIO_OUTPUT_PUSHPULL);
     LL_GPIO_SetPinSpeed(GPIOA, LL_GPIO_PIN_8, LL_GPIO_SPEED_FREQ_HIGH);
     LL_GPIO_SetPinPull(GPIOA, LL_GPIO_PIN_8, LL_GPIO_PULL_NO);
     LL_GPIO_SetAFPin_8_15(GPIOA, LL_GPIO_PIN_8, LL_GPIO_AF_0);
}


/* USER CODE END 4 */

/**
  * @brief  This function is executed in case of error occurrence.
  * @retval None
  */
void Error_Handler(void)
{
  /* USER CODE BEGIN Error_Handler_Debug */
  /* User can add his own implementation to report the HAL error return state */

  /* USER CODE END Error_Handler_Debug */
}

#ifdef  USE_FULL_ASSERT
/**
  * @brief  Reports the name of the source file and the source line number
  *         where the assert_param error has occurred.
  * @param  file: pointer to the source file name
  * @param  line: assert_param error line source number
  * @retval None
  */
void assert_failed(uint8_t *file, uint32_t line)
{
  /* USER CODE BEGIN 6 */
  /* User can add his own implementation to report the file name and line number,
     tex: printf("Wrong parameters value: file %s on line %d\r\n", file, line) */
  /* USER CODE END 6 */
}
#endif /* USE_FULL_ASSERT */

/************************ (C) COPYRIGHT STMicroelectronics *****END OF FILE****/
